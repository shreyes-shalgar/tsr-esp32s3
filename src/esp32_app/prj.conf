## CMakeLists.txt
```
cmake_minimum_required(VERSION 3.20.0)
find_package(Zephyr REQUIRED HINTS $ENV{ZEPHYR_BASE})
project(tsr_uart_inference_esp32s3)

target_sources(app PRIVATE
  src/main.c
  src/tsr_model.c
  src/tsr_model_data.c
  src/tsr_image.c
)
target_include_directories(app PRIVATE src)

# Zephyr defaults the whole image to -Os. That costs the convolution loop its
# vectorisation: measured on x86 over the 364-image validation set, the same
# kernel runs 3.45 ms/image at -Os and 1.47 ms at -O3. Only the inference
# kernel is compiled for speed, so the flash cost is confined to one file
# instead of the whole image.
set_source_files_properties(
  src/tsr_model.c
  PROPERTIES COMPILE_OPTIONS "-O3"
)
```

## prj.conf
```kconfig
# ---------------------------------------------------------------------------
# UART: polled receive, deliberately NOT interrupt driven.
#
# The first version of this application used CONFIG_UART_INTERRUPT_DRIVEN with
# an ISR feeding a ring buffer, and it silently lost bytes on a fast host
# burst. That is what an ISR does here: it drains the hardware FIFO as fast as
# the line delivers, and the overrun simply moves from the FIFO into the ring
# buffer - where it is discarded without any signal to the sender.
#
# rx_getc() in main.c polls with uart_poll_in() instead, so bytes stay in the
# hardware FIFO until the application takes them.
#
# What that buys depends on the transport, and the distinction matters:
#   - On QEMU the UART is a socket chardev, so a full guest FIFO stops QEMU
#     reading the TCP socket and the host's send() blocks. Verified: a
#     56,180-byte burst - four images back to back, no handshake at all, one
#     write - produced four "RECEIVED 6912 bytes" and four predictions,
#     nothing dropped. That is TCP flow control doing the work.
#   - On real hardware it buys nothing on the wire. Hardware flow control is
#     NOT enabled here (no hw-flow-control in the devicetree, no RTS/CTS
#     Kconfig), so a full FIFO asserts nothing and further bytes are lost.
#     The handshake is the protection: READY is sent only when the receive
#     loop is ready, and send_image.py waits for it. See the comment above
#     rx_getc() in main.c for the numbers.
# ---------------------------------------------------------------------------
CONFIG_SERIAL=y
# CONFIG_UART_INTERRUPT_DRIVEN is not set

# Console kept for the boot banner; the protocol uses the UART driver directly.
CONFIG_CONSOLE=y
CONFIG_UART_CONSOLE=y

# No printf/float formatting is used - keeps the image small.
CONFIG_CBPRINTF_NANO=y

# The inference arena and payload buffer are static; give main a modest stack.
CONFIG_MAIN_STACK_SIZE=4096

CONFIG_BOOT_BANNER=y

# Not newlib. With this unset Zephyr 4.4 selects picolibc (confirmed in the
# generated .config: CONFIG_PICOLIBC=y), which is smaller and already provides
# the one libm call in the image - expf(), used once per prediction to turn the
# int8 logits into the reported confidence percentage. The inference path
# itself is integer-only; nothing in it touches floating point.
CONFIG_NEWLIB_LIBC=n

# ---------------------------------------------------------------------------
# ESP32-S3-DevKitC-1 N16R8: ESP32-S3-WROOM-1 with 16 MB flash and 8 MB octal
# PSRAM. The Zephyr board defaults to an 8 MB flash header, which is wrong for
# this module - esptool writes the size into the image header and the SPI flash
# size register is configured from it.
#
# PSRAM is deliberately left disabled. The whole inference arena is 9,984 bytes
# of internal SRAM; nothing in this application needs external RAM, and not
# enabling it keeps the boot path and the pin configuration simpler.
CONFIG_ESPTOOLPY_FLASHSIZE_16MB=y
```

## boards/esp32s3_devkitc_esp32s3_procpu.overlay
```dts
/*
 * ESP32-S3-DevKitC-1 N16R8 (ESP32-S3-WROOM-1, 16 MB flash, 8 MB octal PSRAM).
 *
 * The in-tree board defines flash0 as 8 MB, and esptool takes the flash size
 * for the image header from that devicetree node - not from
 * CONFIG_ESPTOOLPY_FLASHSIZE. The header value configures the SPI flash size
 * register at boot, so on a 16 MB module it should say 16 MB.
 *
 * Only the size changes. The partition layout in partitions_0x0_amp.dtsi is
 * untouched and lives entirely inside the first 8 MB; this application
 * occupies about 200 KB of it.
 */
&flash0 {
	reg = <0x0 0x1000000>;   /* 16 MB */
};
```

## src/main.c
```c
/*
 * AI Arena 2026 - Track 1 : Traffic Sign Recognition
 * Zephyr UART inference application.
 *
 * Protocol (matches the supplied send_image.py exactly):
 *   board -> host : "READY"
 *   host  -> board: ASCII hex bytes, 32 bytes (64 chars) per line
 *   host  -> board: "STOP"
 *   board -> host : "RECEIVED <n> bytes"
 *   board -> host : "PREDICTION class=<id> label=<name> confidence=<p>%"
 *   board -> host : "READY"                               (ready for the next image)
 *
 * On any failure the board emits a line starting with "ERROR" instead of
 * PREDICTION, so the host never has to wait out its 30 s timeout.
 *
 * The host measures inference time as the gap between the RECEIVED line and
 * the next line it receives, so nothing may be printed between the two.
 *
 * UART: 115200 8N1, no flow control.
 */
#include <zephyr/kernel.h>
#include <zephyr/device.h>
#include <zephyr/drivers/uart.h>
#include <zephyr/sys/util.h>

#include "tsr_model.h"
#include "tsr_image.h"

/* Bump both when the shipped model changes. */
#define TSR_BUILD_TAG  "2026.08.28-t3f"     /* + conv-conv-pool triple fusion */
#define TSR_VAL_ACC    "99.73%"

#define RX_IDLE_TIMEOUT_MS 20000   /* between bytes, once a transfer has begun */
#define RX_ARM_TIMEOUT_MS  3000    /* while idle: re-announce READY this often */

static const struct device *const uart_dev =
	DEVICE_DT_GET(DT_CHOSEN(zephyr_console));

static uint8_t  payload[TSR_PAYLOAD_MAX];
static uint8_t  image[TSR_IMG_BYTES];
static int8_t   scores[TSR_NUM_CLASSES];
#ifdef CONFIG_TSR_REPORT_TIMING
static uint32_t last_infer_us;
#endif

/* ------------------------------------------------------------------ */
/* UART plumbing                                                       */
/* ------------------------------------------------------------------ */

static void uart_write_str(const char *s)
{
	while (*s) {
		uart_poll_out(uart_dev, (unsigned char)*s++);
	}
}

/* Minimal unsigned decimal printer - avoids pulling in printf. */
static void uart_write_u32(uint32_t v)
{
	char b[12];
	int i = 0;

	if (v == 0) {
		uart_poll_out(uart_dev, '0');
		return;
	}
	while (v && i < (int)sizeof(b)) {
		b[i++] = (char)('0' + (v % 10U));
		v /= 10U;
	}
	while (i--) {
		uart_poll_out(uart_dev, (unsigned char)b[i]);
	}
}

/* Polled receive.
 *
 * Polling rather than interrupt-driven RX is deliberate. Bytes stay in the
 * hardware FIFO until this loop takes them, so the FIFO fills when the
 * application is busy. An ISR draining into a ring buffer does the opposite:
 * it empties the FIFO as fast as the line delivers, and the overflow moves
 * into the ring buffer where it is discarded with no signal to anyone. That
 * was observed during development and is why this is polled.
 *
 * Be precise about what a full FIFO actually accomplishes, because it differs
 * by transport:
 *
 *   QEMU  - the UART is a socket chardev. When the guest FIFO is full QEMU
 *           stops reading the TCP socket, the receive window closes and the
 *           host's own send() blocks. That is TCP flow control, and it is
 *           genuine end-to-end backpressure.
 *
 *   Board - hardware flow control is NOT enabled (no hw-flow-control in the
 *           devicetree, no RTS/CTS Kconfig), so a full FIFO asserts nothing on
 *           the wire. Bytes arriving after it fills are lost. The FIFO is 16
 *           bytes on ns16550 and 128 on ESP32-S3, and at 115200 baud a byte
 *           lands every 86 us - so roughly 390 bytes would arrive during a
 *           33 ms inference if a host kept sending through it.
 *
 * On hardware the protection is therefore the protocol, not the peripheral:
 * READY is emitted only when this loop is ready to receive, and the
 * organisers' send_image.py waits for it. A host that ignored the handshake
 * and streamed continuously would overrun a real UART. Enabling RTS/CTS would
 * close that gap, but it needs wiring the evaluation harness may not carry and
 * could not be tested here, so it is documented rather than assumed.
 *
 * Decoding one hex character is a few instructions against 86 us per character
 * at 115200 baud, so while this loop is running it has three orders of
 * magnitude of headroom; the exposure is confined to the inference window.
 */
/* Print basis points (0..10000) as "dd.dd". */
static void uart_write_pct(uint32_t bp)
{
	uart_write_u32(bp / 100U);
	uart_poll_out(uart_dev, '.');
	uart_poll_out(uart_dev, (unsigned char)('0' + ((bp / 10U) % 10U)));
	uart_poll_out(uart_dev, (unsigned char)('0' + (bp % 10U)));
}

static int rx_getc(uint8_t *c, int timeout_ms)
{
	int64_t deadline = k_uptime_get() + timeout_ms;
	uint32_t spins = 0;

	for (;;) {
		if (uart_poll_in(uart_dev, c) == 0) {
			return 0;
		}
		if (++spins >= 2000U) {
			spins = 0;
			if (k_uptime_get() > deadline) {
				return -1;
			}
			k_yield();
		}
	}
}

/* ------------------------------------------------------------------ */
/* Hex stream reception                                                */
/* ------------------------------------------------------------------ */

static inline int hex_val(uint8_t c)
{
	if (c >= '0' && c <= '9') return c - '0';
	if (c >= 'a' && c <= 'f') return c - 'a' + 10;
	if (c >= 'A' && c <= 'F') return c - 'A' + 10;
	return -1;
}

static inline uint8_t up(uint8_t c)
{
	return (c >= 'a' && c <= 'z') ? (uint8_t)(c - 'a' + 'A') : c;
}

/* Returns bytes received, or negative on error.
 *  -1 timeout, -2 overflow, -3 odd number of hex digits */
static int receive_payload(void)
{
	static const char stop[] = "STOP";
	size_t nbytes = 0;
	int hi = -1;
	int match = 0;
	int overflow = 0;
	int started = 0;
	uint8_t c;

	for (;;) {
		if (rx_getc(&c, started ? RX_IDLE_TIMEOUT_MS : RX_ARM_TIMEOUT_MS) != 0) {
			if (!started) {
				/* Still idle. Re-announce READY so a host that attaches
				 * after the first announcement - a fresh run of
				 * send_image.py on an already-running board - sees the
				 * handshake immediately instead of waiting out its
				 * 30 s timeout. */
				uart_write_str("READY\r\n");
				continue;
			}
			return -1;
		}
		started = 1;

		/* End-of-stream token, matched case-insensitively. */
		if (up(c) == (uint8_t)stop[match]) {
			match++;
			if (match == 4) {
				break;
			}
			continue;
		}
		match = (up(c) == (uint8_t)stop[0]) ? 1 : 0;

		int v = hex_val(c);
		if (v < 0) {
			continue;               /* whitespace / CR / LF */
		}
		if (hi < 0) {
			hi = v;
		} else {
			if (nbytes < TSR_PAYLOAD_MAX) {
				payload[nbytes++] = (uint8_t)((hi << 4) | v);
			} else {
				overflow = 1;
			}
			hi = -1;
		}
	}

	if (overflow) {
		return -2;
	}
	if (hi >= 0) {
		return -3;
	}
	return (int)nbytes;
}

/* ------------------------------------------------------------------ */

int main(void)
{
	int n, idx, rc;

	if (!device_is_ready(uart_dev)) {
		return -1;
	}

	/* Version line. Printed once at boot, before the protocol starts, so it
	 * cannot interfere with the host's parsing - and it makes "which build am
	 * I actually running?" answerable at a glance. */
	uart_write_str("\r\nTSR " TSR_BUILD_TAG " | 48x48x3 | 17 classes | arena ");
	uart_write_u32(tsr_arena_bytes());
	uart_write_str(" B | val " TSR_VAL_ACC "\r\n");

	for (;;) {
		uart_write_str("READY\r\n");

		n = receive_payload();
		if (n < 0) {
			uart_write_str(n == -1 ? "ERROR timeout waiting for data\r\n" :
				       n == -2 ? "ERROR payload too large\r\n" :
						 "ERROR odd number of hex digits\r\n");
			continue;
		}

		/* Host starts its inference timer on this line and stops it on the
		 * next one, so nothing may be emitted in between. */
		uart_write_str("RECEIVED ");
		uart_write_u32((uint32_t)n);
		uart_write_str(" bytes\r\n");

		rc = tsr_prepare_input(payload, (size_t)n, image);
		if (rc != 0) {
			uart_write_str("ERROR unexpected payload size ");
			uart_write_u32((uint32_t)n);
			uart_write_str("\r\n");
			continue;
		}

#ifdef CONFIG_TSR_REPORT_TIMING
		{
			uint32_t c0 = k_cycle_get_32();
			idx = tsr_predict(image, scores);
			last_infer_us = k_cyc_to_us_floor32(k_cycle_get_32() - c0);
		}
#else
		idx = tsr_predict(image, scores);
#endif

		/* class= carries the OFFICIAL challenge class ID (0, 2-7, 24, 43,
		 * 69, 70, 72, 83-87), not the 0-16 array index, as the challenge
		 * guide requires. */
		uart_write_str("PREDICTION class=");
		uart_write_u32((uint32_t)tsr_class_id(idx));
		uart_write_str(" label=");
		uart_write_str(tsr_class_names[idx]);
		uart_write_str(" confidence=");
		uart_write_pct(tsr_confidence_bp(scores, idx));
		uart_write_str("%\r\n");

#ifdef CONFIG_TSR_REPORT_TIMING
		/* Benchmark builds only. The host times inference as the gap between
		 * RECEIVED and the next line, so this is emitted AFTER PREDICTION,
		 * where it cannot contaminate that measurement - and it is compiled
		 * out of the shipping image entirely. */
		uart_write_str("TIMING infer_us=");
		uart_write_u32(last_infer_us);
		uart_write_str("\r\n");
#endif
	}

	return 0;
}
```

## src/tsr_image.h
```c
/* Payload -> 48x48x3 RGB normalisation.
 *
 * send_image.py can present three different payloads:
 *   64*64*3 = 12288  RGB          (script default)
 *   48*48*3 =  6912  RGB          (challenge guide)
 *   48*48   =  2304  grayscale    (script -g flag)
 * The firmware accepts all three and normalises to the model input.
 */
#ifndef TSR_IMAGE_H
#define TSR_IMAGE_H

#include <stdint.h>
#include <stddef.h>

#define TSR_PAYLOAD_RGB64   (64 * 64 * 3)
#define TSR_PAYLOAD_RGB48   (48 * 48 * 3)
#define TSR_PAYLOAD_GRAY48  (48 * 48)
#define TSR_PAYLOAD_MAX     TSR_PAYLOAD_RGB64

/* Returns 0 on success, -1 if len is not a recognised payload size.
 * `out` must hold 48*48*3 bytes. */
int tsr_prepare_input(const uint8_t *payload, size_t len, uint8_t *out);

/* Human-readable description of the last accepted payload format. */
const char *tsr_last_format(void);

#endif /* TSR_IMAGE_H */
```

## src/tsr_model_data.h
```c
/* Auto-generated by export_c_model.py - do not edit. */
#ifndef TSR_MODEL_DATA_H
#define TSR_MODEL_DATA_H
#include <stdint.h>

#define TSR_IMG_H 48
#define TSR_IMG_W 48
#define TSR_IMG_C 3
#define TSR_IMG_BYTES (6912)
#define TSR_NUM_CLASSES 17
#define TSR_NUM_LAYERS 8
#define TSR_BUF_A 4608
#define TSR_BUF_B 2304
#define TSR_SCRATCH 3072
#define TSR_ARENA_BYTES (4608 + 2304 + 3072)

typedef enum { TSR_OP_CONV=0, TSR_OP_MAXPOOL=1,
               TSR_OP_AVGPOOL=2, TSR_OP_FC=3 } tsr_op_t;

typedef struct {
  uint8_t  op, stride, ksize, pad;
  uint16_t in_h, in_w, in_c;
  uint16_t out_h, out_w, out_c;
  const int8_t  *w;
  const int32_t *bias;
  const int32_t *mult;
  const int32_t *shift;
  int16_t in_zp, out_zp;
} tsr_layer_t;

extern const tsr_layer_t tsr_layers[TSR_NUM_LAYERS];
extern const int16_t tsr_class_ids[TSR_NUM_CLASSES];
extern const char *const tsr_class_names[TSR_NUM_CLASSES];

/* Output dequantisation, for the confidence figure. */
#define TSR_OUT_SCALE 0.3961435258f
#define TSR_OUT_ZP (46)
#endif /* TSR_MODEL_DATA_H */
```
